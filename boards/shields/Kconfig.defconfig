## boards/shields/Kconfig.defconfig
```kconfig
if SHIELD_KSPLIT2D_LEFT

# Name must be less than 16 characters long!
config ZMK_KEYBOARD_NAME
    default "KSPLIT2"

config ZMK_SPLIT_ROLE_CENTRAL
    default y

endif

if SHIELD_KSPLIT2_LEFT || SHIELD_KSPLIT2_RIGHT

config ZMK_SPLIT
    default y

endif
```

## boards/shields/ksplit2/Kconfig.defconfig
```kconfig
if KSPLIT2_LEFT

config ZMK_KEYBOARD_NAME
	default "ksplit"

config ZMK_SPLIT_ROLE_CENTRAL
	default y

endif

if SHIELD_KSPLIT_RIGHT

config ZMK_KEYBOARD_NAME
	default "ksplit Right"

endif

if SHIELD_KSPLIT_LEFT || SHIELD_KSPLIT_RIGHT

config ZMK_SPLIT
	default y
	
endif
```

## boards/shields/ksplit2/Kconfig.shield
```kconfig
config SHIELD_KSPLIT_LEFT
    def_bool $(shields_list_contains,ksplit2_left)

config SHIELD_KSPLIT_RIGHT
    def_bool $(shields_list_contains,ksplit2_right)
```
